## CMakeLists.txt
```
cmake_minimum_required(VERSION 3.20.0)
find_package(Zephyr REQUIRED HINTS $ENV{ZEPHYR_BASE})

project(STBS)

# Include main source file
target_sources(app PRIVATE src/main.c)

# Automatically include all `.c` files from the 'src' directory
file(GLOB SRC_SOURCES src/*.c)

# Automatically include all `.c` files from the 'lib' directory
file(GLOB LIB_SOURCES lib/*.h)

# Add them to the app target
target_sources(app PRIVATE ${SRC_SOURCES} ${LIB_SOURCES})

# Add the 'lib' directory to the include paths
target_include_directories(app PRIVATE lib)
```

## prj.conf
```kconfig
CONFIG_SYS_CLOCK_TICKS_PER_SEC=1000
CONFIG_TIMING_FUNCTIONS=y
CONFIG_PRINTK=y
CONFIG_UART_CONSOLE=y
CONFIG_GPIO=y
```

## src/main.c
```c
#include <zephyr/kernel.h>       
#include <zephyr/sys/printk.h>     
#include <zephyr/timing/timing.h>   
#include "../lib/tasks.h"

#define STACK_SIZE 1024
#define thread_A_prio 1
#define thread_B_prio 1
#define thread_C_prio 1
#define thread_A_period 3000

K_THREAD_STACK_DEFINE(led_stack, STACK_SIZE);
K_THREAD_STACK_DEFINE(btn_stack, STACK_SIZE);
K_THREAD_STACK_DEFINE(rtdb_stack, STACK_SIZE);

struct k_thread led_data;
struct k_thread btn_data;
struct k_thread rtdb_data;

void led_thread_code(void *argA, void *argB, void *argC);
void btn_thread_code(void *argA, void *argB, void *argC);
void rtdb_thread_code(void *argA , void *argB, void *argC);

k_tid_t led_tid;
k_tid_t btn_tid;
k_tid_t rtdb_tid;


struct k_sem btn_sem;
struct k_sem led_sem;
struct k_sem print_rtdb_sem;

int main(void) {

    k_msleep(3000);

    k_sem_init(&btn_sem, 0, 1);
    k_sem_init(&led_sem, 0, 1);
    k_sem_init(&print_rtdb_sem, 0, 1);

    k_sem_take(&btn_sem, K_NO_WAIT);
    k_sem_take(&led_sem, K_NO_WAIT);
    k_sem_take(&print_rtdb_sem, K_NO_WAIT);

    stbs_add_task(PRINT_RTDB_ID, 1000, 15, &print_rtdb_sem);
    stbs_add_task(BTN_HANDLER_ID, 200, 5, &btn_sem);
    stbs_add_task(LED_HANDLER_ID, 20, 5, &led_sem);
    stbs_init();

    stbs_start();

    timing_init();
    timing_start();

    led_tid = k_thread_create(&led_data, led_stack, STACK_SIZE, led_thread_code, NULL, NULL, NULL, thread_A_prio, 0, K_NO_WAIT);
    btn_tid = k_thread_create(&btn_data, btn_stack, STACK_SIZE, btn_thread_code, NULL, NULL, NULL, thread_B_prio, 0, K_NO_WAIT);
    rtdb_tid = k_thread_create(&rtdb_data, rtdb_stack, STACK_SIZE, rtdb_thread_code, NULL, NULL, NULL, thread_C_prio, 0, K_NO_WAIT);

    return 0;
} 

void led_thread_code(void *argA , void *argB, void *argC)
{ 
    
    /* Variables to time execution */
    timing_t start_time, end_time;
    uint64_t total_cycles=0;
    uint64_t total_ns=0;
    printk("Led Thread init (periodic)\n");
    /* Compute next release instant */
    int ret = initialize_leds();
    if(ret < 0){
        printk("Error initializing leds\n");
    }

    /* Thread loop */
    while(1) {

        if(k_sem_take(&led_sem, K_FOREVER) == 0){
            /* Do the workload */  
            start_time = timing_counter_get(); 
            
            int ret = led_handler();
            if(ret < 0){
                printk("Error handling leds\n");
            }
            end_time = timing_counter_get();
            total_cycles = timing_cycles_get(&start_time, &end_time);
            total_ns = timing_cycles_to_ns(total_cycles);
            //printk("Led Thread took %lld (ns) to execute\n", total_ns);
            
        }    
    }
    /* Stop timing functions */
    timing_stop();
}

/* Thread code implementation */
void btn_thread_code(void *argA , void *argB, void *argC)
{ 
    
    /* Variables to time execution */
    timing_t start_time, end_time;
    uint64_t total_cycles=0;
    uint64_t total_ns=0;
    printk("Button thread init (periodic)\n");
    /* Compute next release instant */
    int ret = initialize_buttons();
    if(ret < 0){
        printk("Error initializing buttons\n");
    }

    /* Thread loop */
    while(1) {

        if(k_sem_take(&btn_sem, K_FOREVER) == 0){
            /* Do the workload */  
            start_time = timing_counter_get(); 
            
            int ret = btn_handler();
            if(ret < 0){
                printk("Error handling buttons\n");
            }
            end_time = timing_counter_get();
            total_cycles = timing_cycles_get(&start_time, &end_time);
            total_ns = timing_cycles_to_ns(total_cycles);
            //printk("Button thread took %lld (ns) to execute\n", total_ns);
        }    
    }
    /* Stop timing functions */
    timing_stop();
}

/* Thread code implementation */
void rtdb_thread_code(void *argA , void *argB, void *argC)
{ 
    
    /* Variables to time execution */
    timing_t start_time, end_time;
    uint64_t total_cycles=0;
    uint64_t total_ns=0;
    printk("Print RTDB thread init (periodic)\n");

    /* Thread loop */
    while(1) {

        if(k_sem_take(&print_rtdb_sem, K_FOREVER) == 0){
            /* Do the workload */  
            start_time = timing_counter_get(); 
            
            print_rtdb();
            end_time = timing_counter_get();
            total_cycles = timing_cycles_get(&start_time, &end_time);
            total_ns = timing_cycles_to_ns(total_cycles);
            //printk("Print RTDB thread took %lld (ns) to execute\n", total_ns);
            
        }    
    }
    /* Stop timing functions */
    timing_stop();
}
```

## src/fifo.c
```c
#include "../lib/fifo.h"

void fifo_init(FIFO *fifo) {
    fifo->front = 0;
    fifo->rear = 0;
    fifo->count = 0;
}

bool fifo_is_empty(FIFO *fifo) {
    return fifo->count == 0;
}

bool fifo_is_full(FIFO *fifo) {
    return fifo->count == FIFO_SIZE;
}

bool fifo_push(FIFO *fifo, struct k_sem* value) {
    if (fifo_is_full(fifo)) {
        printf("FIFO is full\n");
        return false;
    }
    //Point to the same semaphore
    fifo->buffer[fifo->rear] = *value;
    fifo->rear = (fifo->rear + 1) % FIFO_SIZE;
    fifo->count++;
    return true;
}

void fifo_pop(FIFO *fifo, struct k_sem *value) {
    if (fifo_is_empty(fifo)) {
        printf("FIFO is empty\n");
        return NULL; // Indicate error (e.g., no element to dequeue)
    }
    value = &(fifo->buffer[fifo->front]);
    fifo->front = (fifo->front + 1) % FIFO_SIZE;
    fifo->count--;
}

void fifo_print(FIFO *fifo) {
    printf("FIFO contents: ");
    for (int i = 0, idx = fifo->front; i < fifo->count; i++) {
        printf("%d ", fifo->buffer[idx]);
        idx = (idx + 1) % FIFO_SIZE;
    }
    printf("\n");
}
```

## src/stbs.c
```c
#include "../lib/stbs.h"

uint16_t hyper_period;
uint16_t minor_cycle;
uint16_t num_ticks;

uint16_t tick_count = 0;


task_t task_table[MAX_TASKS];
uint32_t num_tasks = 0;
uint8_t tick_scheduler[100][MAX_TASKS];

tick_manager_t tick_manager;

struct k_thread tick_handler_thread;
k_tid_t tick_handler_tid;

struct k_sem tick_handler_sem;

K_THREAD_STACK_DEFINE(tick_handler_stack, 1024);

void tick_handler()
{
    //At each tick, check what tasks are ready to run
    for(int i = 0; i < num_tasks; i++){
        if(tick_scheduler[tick_count][i] == tick_manager.task_ids[0]){
            k_sem_give(tick_manager.semaphores[0]);
        }
        else if(tick_scheduler[tick_count][i] == tick_manager.task_ids[1]){
            k_sem_give(tick_manager.semaphores[1]);
        }
        else if(tick_scheduler[tick_count][i] == tick_manager.task_ids[2]){
            k_sem_give(tick_manager.semaphores[2]);
        }
        else if(tick_scheduler[tick_count][i] == tick_manager.task_ids[3]){
            k_sem_give(tick_manager.semaphores[3]);
        }
        else if(tick_scheduler[tick_count][i] == tick_manager.task_ids[4]){
            k_sem_give(tick_manager.semaphores[4]);
        }
        else if(tick_scheduler[tick_count][i] == tick_manager.task_ids[5]){
            k_sem_give(tick_manager.semaphores[5]);
        }
        else if(tick_scheduler[tick_count][i] == tick_manager.task_ids[6]){
            k_sem_give(tick_manager.semaphores[6]);
        }
        else if(tick_scheduler[tick_count][i] == tick_manager.task_ids[7]){
            k_sem_give(tick_manager.semaphores[7]);
        }
        else if(tick_scheduler[tick_count][i] == tick_manager.task_ids[8]){
            k_sem_give(tick_manager.semaphores[8]);
        }
        else if(tick_scheduler[tick_count][i] == tick_manager.task_ids[9]){
            k_sem_give(tick_manager.semaphores[9]);
        }
    }
    tick_count++;
    if(tick_count == num_ticks){
        tick_count = 0;
    }
}

void tick_thread_code(void *argA , void *argB, void *argC)
{
    /* Timing variables to control task periodicity */
    int64_t fin_time=0, release_time=0;
    
    /* Variables to time execution */
    timing_t start_time, end_time;
    uint64_t total_cycles=0;
    uint64_t total_ns=0;

    printk("Tick Thread init (periodic)\n");

    /* Compute next release instant */
    printk("Minor cycle at tick thread: %d\n", minor_cycle);
    release_time = k_uptime_get() + minor_cycle;

    /* Thread loop */
    while(1) {
        if(k_sem_take(&tick_handler_sem, K_FOREVER) == 0){
            /* Do the workload */  
            start_time = timing_counter_get(); 
            //printk("Tick thread instance released at time: %lld (ms). Last instance exec time was %lld (ns) \n",k_uptime_get(),total_ns);  
            tick_handler();

            end_time = timing_counter_get();

            total_cycles = timing_cycles_get(&start_time, &end_time);
            total_ns = timing_cycles_to_ns(total_cycles);
            //printk("Tick handler took %lld (ns) to execute\n", total_ns);
        
            /* Wait for next release instant */ 
            fin_time = k_uptime_get();
            if( fin_time < release_time) {
                k_msleep(release_time - fin_time); /* There are other variants, k_sleep(), k_usleep(), ... */
                release_time += minor_cycle;

            }
            k_sem_give(&tick_handler_sem);
        }
    }

    /* Stop timing functions */
    timing_stop();
}

void stbs_init(void){
    k_sem_init(&tick_handler_sem, 0, 1);
    
    // Sort tasks by period
    for (uint32_t i = 0; i < num_tasks - 1; i++) {
        for (uint32_t j = i + 1; j < num_tasks; j++) {
            if (task_table[i].period_ticks > task_table[j].period_ticks) {
                task_t temp = task_table[i];
                task_table[i] = task_table[j];
                task_table[j] = temp;
            }
        }
    }

    // Calculate hyper-period
    hyper_period = 1;
    for (uint16_t i = 0; i < num_tasks; i++) {
        hyper_period = lcm(hyper_period, task_table[i].period_ticks);
    }

    // Calculate minor cycle
    minor_cycle = task_table[0].period_ticks;
    for (uint32_t i = 1; i < num_tasks; i++) {
        minor_cycle = gcd(minor_cycle, task_table[i].period_ticks);
    }

    printk("Hyper period: %d\n", hyper_period);
    printk("Minor cycle: %d\n", minor_cycle);

    num_ticks = hyper_period / minor_cycle;

    tick_handler_tid = k_thread_create(&tick_handler_thread, tick_handler_stack, 1024, tick_thread_code, NULL, NULL, NULL, TICK_HANDLER_PRIORITY, 0, K_NO_WAIT);
}

void stbs_add_task(uint8_t task_id, uint32_t period_ticks, uint16_t worst_case_execution_time, struct k_sem* semaphore){
    if(num_tasks >= MAX_TASKS){
        printk("Error: Maximum number of tasks reached\n");
        return;
    }
    task_table[num_tasks] = (task_t){.period_ticks = period_ticks, .task_id = task_id, 
        .worst_case_execution_time = worst_case_execution_time};

    tick_manager.task_ids[num_tasks] = task_id;
    tick_manager.semaphores[num_tasks] = semaphore;

    num_tasks++;
}

void stbs_create_tick_scheduler(void){
    task_t postponed_tasks[MAX_TASKS];
    uint8_t num_postponed_tasks = 0;
    
    for (uint16_t t = 0; t < hyper_period; t += minor_cycle) {
        printk("Iteration %d\n", t);
        uint16_t used_time = 0;

        // Schedule tasks in priority order
        for (int i = 0; i < num_tasks; i++) {
            if (t % task_table[i].period_ticks == 0) {
                printk("Task %d selected for tick %d\n", i, t);
                if (used_time + task_table[i].worst_case_execution_time <= minor_cycle) {
                    printk("Task %d scheduled\n", i);
                    tick_scheduler[t / minor_cycle][i] = task_table[i].task_id;
                    used_time += task_table[i].worst_case_execution_time;
                } else {
                    printk("Task %d deferred\n", i);
                    tick_scheduler[t / minor_cycle][i] = 255;
                    postponed_tasks[num_postponed_tasks] = task_table[i];
                    num_postponed_tasks++;
                }
            }
            else {          
                tick_scheduler[t / minor_cycle][i] =  255;
            }
        }

        // Print contents of deferred tasks
        printk("Postponed tasks: \n");
        for (int i = 0; i < num_postponed_tasks; i++) {
            printk("%d \n", postponed_tasks[i].task_id);
        }

        // Attempt to reschedule deferred tasks
        task_t temp_task_table[MAX_TASKS];
        uint8_t temp_num_tasks = 0;

        
        for(int i = 0; i < num_postponed_tasks; i++){
            printk("There are deferred tasks\n");
            int task_idx = -1;

            for (int j = 0; j < num_tasks; j++) {
                if (task_table[j].task_id == postponed_tasks[i].task_id) {
                    printk("Task %d found with id %d\n", j, task_table[j].task_id);
                    task_idx = j;
                    break;
                }
            }

            if (task_idx >= 0 && used_time + task_table[task_idx].worst_case_execution_time <= minor_cycle) {
                tick_scheduler[t / minor_cycle][task_idx] = task_table[task_idx].task_id;
                used_time += task_table[task_idx].worst_case_execution_time;
            } else {
                printk("Task %d deferred again\n", task_idx);
                temp_task_table[temp_num_tasks] = task_table[task_idx];
                temp_num_tasks++;
            }
        }

        //printk("Temp queue is empty: %d\n", fifo_is_empty(temp_queue));

        // Move remaining deferred tasks back
        if(temp_num_tasks > 0){
            for (int i = 0; i < temp_num_tasks; i++) {
                postponed_tasks[i] = temp_task_table[i];
            }
            num_postponed_tasks = temp_num_tasks;
        }
        else{
            num_postponed_tasks = 0;
        }
        temp_num_tasks = 0;
    }
    printk("---------------------------------------------------------\n");
    printk("---------------------------------------------------------\n");
}


void stbs_start(void){
    //Start tick thread

    stbs_create_tick_scheduler();
    timing_init();
    timing_start();
    k_sem_give(&tick_handler_sem);
}

void stbs_stop(void){
    //Stop tick thread
    k_sem_take(&tick_handler_sem, K_FOREVER);
}

uint16_t lcm(uint16_t a, uint16_t b){
    return (a * b) / gcd(a, b);
}

uint16_t gcd(uint16_t a, uint16_t b){
    if(b == 0)
        return a;
    return gcd(b, a % b);
}
```

## src/tasks.c
```c
#include "../lib/tasks.h"

rtdb_t rtdb = {1, 1, 1, 1, 0, 0};

int btn_handler()
{
    //printk("Button handler goes on\n");
    rtdb.n_execs_btn_handler++;
    //Button 1
    if(gpio_pin_get_dt(&button_1)){
        rtdb.btn_value_0 = !rtdb.btn_value_0;
    }

    //Button 2
    if(gpio_pin_get_dt(&button_2)){
        rtdb.btn_value_1 = !rtdb.btn_value_1;
    }

    //Button 3
    if(gpio_pin_get_dt(&button_3)){
        rtdb.btn_value_2 = !rtdb.btn_value_2;
    }

    //Button 4
    if(gpio_pin_get_dt(&button_4)){
        rtdb.btn_value_3 = !rtdb.btn_value_3;
    }

    return 0;
}

int initialize_buttons()
{
    int ret;

    //Button 1
    if(!device_is_ready(button_1.port)) {
        printk("Device %s is not ready\n", button_1.port->name);
        return -1;
    }

    ret = gpio_pin_configure_dt(&button_1, GPIO_INPUT);
    if (ret < 0) {
        return -1;
    }

    //Button 2
    if(!device_is_ready(button_2.port)) {
        printk("Device %s is not ready\n", button_2.port->name);
        return -1;
    }

    ret = gpio_pin_configure_dt(&button_2, GPIO_INPUT);
    if (ret < 0) {
        return -1;
    }

    //Button 3
    if(!device_is_ready(button_3.port)) {
        printk("Device %s is not ready\n", button_3.port->name);
        return -1;
    }

    ret = gpio_pin_configure_dt(&button_3, GPIO_INPUT);
    if (ret < 0) {
        return -1;
    }

    //Button 4
    if(!device_is_ready(button_4.port)) {
        printk("Device %s is not ready\n", button_4.port->name);
        return -1;
    }

    ret = gpio_pin_configure_dt(&button_4, GPIO_INPUT);
    if (ret < 0) {
        return -1;
    }

    return 0;
}

int led_handler()
{
    //printk("LED goes on\n");
    rtdb.n_execs_led_handler++;
    //LED 1
    gpio_pin_set_dt(&led_1, rtdb.btn_value_0);

    //LED 2
    gpio_pin_set_dt(&led_2, rtdb.btn_value_1);

    //LED 3
    gpio_pin_set_dt(&led_3, rtdb.btn_value_2);

    //LED 4
    gpio_pin_set_dt(&led_4, rtdb.btn_value_3);

    return 0;
}

int initialize_leds(){
    int ret;

    //LED 1
    if(!device_is_ready(led_1.port)) {
        printk("Device %s is not ready\n", led_1.port->name);
        return -1;
    }

    ret = gpio_pin_configure_dt(&led_1, GPIO_OUTPUT_INACTIVE);
    if (ret < 0) {
        return -1;
    }

    //LED 2
    if(!device_is_ready(led_2.port)) {
        printk("Device %s is not ready\n", led_2.port->name);
        return -1;
    }

    ret = gpio_pin_configure_dt(&led_2, GPIO_OUTPUT_INACTIVE);
    if (ret < 0) {
        return -1;
    }

    //LED 3
    if(!device_is_ready(led_3.port)) {
        printk("Device %s is not ready\n", led_3.port->name);
        return -1;
    }

    ret = gpio_pin_configure_dt(&led_3, GPIO_OUTPUT_INACTIVE);
    if (ret < 0) {
        return -1;
    }

    //LED 4
    if(!device_is_ready(led_4.port)) {
        printk("Device %s is not ready\n", led_4.port->name);
        return -1;
    }

    ret = gpio_pin_configure_dt(&led_4, GPIO_OUTPUT_INACTIVE);
    if (ret < 0) {
        return -1;
    }

    return 0;

}

void print_rtdb()
{
    printk("Button 1: %d\n Button 2: %d\n Button 3: %d\n Button 4: %d\n Button handler executions: %d\n LED handler executions: %d\n", 
            rtdb.btn_value_0, rtdb.btn_value_1, rtdb.btn_value_2, rtdb.btn_value_3, 
            rtdb.n_execs_btn_handler, rtdb.n_execs_led_handler
    );
    rtdb.n_execs_btn_handler = 0;
    rtdb.n_execs_led_handler = 0;
}
```
